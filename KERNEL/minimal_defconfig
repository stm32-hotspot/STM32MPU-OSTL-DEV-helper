## KERNEL/minimal_defconfig
```kconfig
CONFIG_SYSVIPC=y
CONFIG_POSIX_MQUEUE=y
CONFIG_GENERIC_IRQ_DEBUGFS=y
CONFIG_NO_HZ_IDLE=y
CONFIG_HIGH_RES_TIMERS=y
CONFIG_BPF_SYSCALL=y
CONFIG_BPF_JIT=y
CONFIG_PREEMPT=y
CONFIG_IRQ_TIME_ACCOUNTING=y
CONFIG_BSD_PROCESS_ACCT=y
CONFIG_BSD_PROCESS_ACCT_V3=y
CONFIG_TASKSTATS=y
CONFIG_TASK_DELAY_ACCT=y
CONFIG_TASK_XACCT=y
CONFIG_TASK_IO_ACCOUNTING=y
CONFIG_IKCONFIG=y
CONFIG_IKCONFIG_PROC=y
CONFIG_MEMCG=y
CONFIG_BLK_CGROUP=y
CONFIG_CFS_BANDWIDTH=y
CONFIG_CGROUP_PIDS=y
CONFIG_CGROUP_FREEZER=y
CONFIG_CGROUP_HUGETLB=y
CONFIG_CPUSETS=y
CONFIG_CGROUP_DEVICE=y
CONFIG_CGROUP_CPUACCT=y
CONFIG_CGROUP_PERF=y
CONFIG_CGROUP_BPF=y
CONFIG_USER_NS=y
CONFIG_CHECKPOINT_RESTORE=y
CONFIG_SCHED_AUTOGROUP=y
CONFIG_BLK_DEV_INITRD=y
CONFIG_PROFILING=y
CONFIG_KEXEC_FILE=y
CONFIG_CRASH_DUMP=y
CONFIG_ARCH_STM32=y
CONFIG_ARM64_VA_BITS_48=y
CONFIG_SCHED_MC=y
CONFIG_SCHED_SMT=y
CONFIG_NR_CPUS=2
CONFIG_HOTPLUG_CPU=y
CONFIG_COMPAT=y
CONFIG_RANDOMIZE_BASE=y
# CONFIG_EFI is not set
# CONFIG_SUSPEND is not set
CONFIG_KPROBES=y
CONFIG_JUMP_LABEL=y
# CONFIG_GCC_PLUGINS is not set
CONFIG_MODULES=y
CONFIG_MODULE_UNLOAD=y
CONFIG_MODVERSIONS=y
CONFIG_BLK_DEV_INTEGRITY=y
# CONFIG_BLK_DEBUG_FS is not set
# CONFIG_CORE_DUMP_DEFAULT_ELF_HEADERS is not set
# CONFIG_COMPAT_BRK is not set
CONFIG_MEMORY_HOTPLUG=y
CONFIG_MEMORY_HOTREMOVE=y
CONFIG_PAGE_REPORTING=y
CONFIG_KSM=y
CONFIG_MEMORY_FAILURE=y
CONFIG_TRANSPARENT_HUGEPAGE=y
CONFIG_CMA=y
CONFIG_CMA_AREAS=19
CONFIG_NET=y
CONFIG_PACKET=y
CONFIG_UNIX=y
CONFIG_INET=y
# CONFIG_INET_DIAG is not set
# CONFIG_IPV6 is not set
CONFIG_DNS_RESOLVER=y
# CONFIG_PCPU_DEV_REFCNT is not set
CONFIG_FAILOVER=y
# CONFIG_ETHTOOL_NETLINK is not set
CONFIG_DEVTMPFS=y
CONFIG_DEVTMPFS_MOUNT=y
CONFIG_SCMI_STM32MP_OSTL_V5=y
CONFIG_ARM_SCPI_PROTOCOL=y
CONFIG_OF_OVERLAY=y
CONFIG_BLK_DEV_LOOP=y
CONFIG_SCSI=y
# CONFIG_SCSI_PROC_FS is not set
CONFIG_BLK_DEV_SD=y
CONFIG_SCSI_SAS_LIBSAS=y
CONFIG_INPUT_FF_MEMLESS=y
# CONFIG_INPUT_KEYBOARD is not set
# CONFIG_INPUT_MOUSE is not set
# CONFIG_SERIO is not set
CONFIG_VT_HW_CONSOLE_BINDING=y
CONFIG_LEGACY_PTY_COUNT=16
CONFIG_SERIAL_8250=y
CONFIG_SERIAL_8250_CONSOLE=y
CONFIG_SERIAL_8250_EXTENDED=y
CONFIG_SERIAL_8250_SHARE_IRQ=y
CONFIG_SERIAL_OF_PLATFORM=y
CONFIG_SERIAL_STM32=y
CONFIG_SERIAL_STM32_CONSOLE=y
# CONFIG_HW_RANDOM is not set
# CONFIG_I2C_COMPAT is not set
CONFIG_I2C_CHARDEV=y
# CONFIG_I2C_HELPER_AUTO is not set
CONFIG_I2C_ALGOBIT=y
CONFIG_I2C_DESIGNWARE_PLATFORM=y
CONFIG_I2C_RK3X=y
CONFIG_I2C_STM32F7=y
CONFIG_I3C=y
CONFIG_SPI=y
CONFIG_SPI_MEM=y
CONFIG_PPS=y
CONFIG_PINCTRL_SINGLE=y
# CONFIG_PINCTRL_STM32MP215 is not set
# CONFIG_PINCTRL_STM32MP235 is not set
# CONFIG_PINCTRL_STM32_HDP is not set
# CONFIG_HWMON is not set
CONFIG_THERMAL=y
CONFIG_MFD_ROHM_BD718XX=y
CONFIG_REGULATOR=y
# CONFIG_HID_SUPPORT is not set
# CONFIG_USB_SUPPORT is not set
CONFIG_MMC=y
CONFIG_MMC_BLOCK_MINORS=32
CONFIG_MMC_ARMMMCI=y
CONFIG_MMC_CQHCI=y
CONFIG_DMADEVICES=y
CONFIG_STM32_DMA3=y
CONFIG_SYNC_FILE=y
# CONFIG_VIRTIO_MENU is not set
# CONFIG_VHOST_MENU is not set
# CONFIG_SURFACE_PLATFORMS is not set
CONFIG_COMMON_CLK_SCPI=y
CONFIG_COMMON_CLK_CS2000_CP=y
CONFIG_COMMON_CLK_XGENE=y
CONFIG_COMMON_CLK_RS9_PCIE=y
CONFIG_COMMON_CLK_VC5=y
CONFIG_MAILBOX=y
CONFIG_ARM_MHU=y
CONFIG_PLATFORM_MHU=y
CONFIG_STM32_IPCC=y
CONFIG_MAILBOX_CDEV=y
# CONFIG_IOMMU_SUPPORT is not set
# CONFIG_STM32_RISAB is not set
# CONFIG_STM32_RISAF is not set
# CONFIG_STM32MP_EXTI is not set
# CONFIG_RESET_SCMI is not set
CONFIG_GENERIC_PHY=y
# CONFIG_ARM_PMU is not set
# CONFIG_STM32_DDR_PMU is not set
CONFIG_STM=y
CONFIG_TEE=y
CONFIG_OPTEE=y
CONFIG_EXT4_FS=y
CONFIG_EXT4_FS_POSIX_ACL=y
CONFIG_FANOTIFY=y
CONFIG_FANOTIFY_ACCESS_PERMISSIONS=y
CONFIG_VFAT_FS=y
CONFIG_TMPFS=y
CONFIG_TMPFS_POSIX_ACL=y
CONFIG_HUGETLBFS=y
# CONFIG_MISC_FILESYSTEMS is not set
# CONFIG_NETWORK_FILESYSTEMS is not set
CONFIG_NLS_CODEPAGE_437=y
CONFIG_NLS_ISO8859_1=y
CONFIG_KEYS=y
CONFIG_SECURITY=y
CONFIG_SECURITYFS=y
CONFIG_CRYPTO_RSA=y
CONFIG_CRYPTO_ECHAINIV=y
CONFIG_CRYPTO_DEFLATE=y
CONFIG_CRYPTO_LZO=y
CONFIG_CRYPTO_ZSTD=y
CONFIG_CRYPTO_ANSI_CPRNG=y
CONFIG_CRYPTO_USER_API_HASH=y
CONFIG_CRYPTO_GHASH_ARM64_CE=y
CONFIG_CRYPTO_SHA1_ARM64_CE=y
CONFIG_CRYPTO_SHA2_ARM64_CE=y
CONFIG_CRYPTO_AES_ARM64_CE_BLK=y
CONFIG_CRYPTO_AES_ARM64_CE_CCM=y
CONFIG_ASYMMETRIC_KEY_TYPE=y
CONFIG_ASYMMETRIC_PUBLIC_KEY_SUBTYPE=y
CONFIG_X509_CERTIFICATE_PARSER=y
CONFIG_PKCS7_MESSAGE_PARSER=y
CONFIG_SYSTEM_TRUSTED_KEYRING=y
CONFIG_PACKING=y
CONFIG_INDIRECT_PIO=y
CONFIG_CRC_CCITT=y
CONFIG_CRC_ITU_T=y
CONFIG_CRC7=y
CONFIG_CRC8=y
CONFIG_DMA_RESTRICTED_POOL=y
CONFIG_DMA_CMA=y
CONFIG_CMA_SIZE_MBYTES=32
CONFIG_IRQ_POLL=y
CONFIG_PRINTK_TIME=y
CONFIG_DYNAMIC_DEBUG=y
CONFIG_MAGIC_SYSRQ=y
CONFIG_DEBUG_FS=y
# CONFIG_STRICT_DEVMEM is not set
CONFIG_MEMTEST=y
```

## YOCTO/meta-mylayer/conf/machine/stm32mp25-myboard.conf
```bitbake
#@TYPE: Machine
#@NAME: stm32mp25-myboard
#@DESCRIPTION: Configuration for all STM32MP25 myboard boards (MYBOARD)
#@NEEDED_BSPLAYERS: layers/meta-openembedded/meta-oe layers/meta-openembedded/meta-python

# Define specific familly common machine name
MACHINEOVERRIDES =. "stm32mp2common:stm32mp25common:"

include conf/machine/include/st-machine-common-stm32mp.inc
include conf/machine/include/st-machine-providers-stm32mp.inc

# =========================================================================
# Chip architecture
# =========================================================================
DEFAULTTUNE = "cortexa35"
include conf/machine/include/arm/armv8a/tune-cortexa35.inc

# =========================================================================
# boot scheme
# =========================================================================
BOOTSCHEME_LABELS = "optee"

# =========================================================================
# boot device
# =========================================================================
# Define the boot device supported
BOOTDEVICE_LABELS += "emmc"
# BOOTDEVICE_LABELS += "nor-sdcard"
# BOOTDEVICE_LABELS += "sdcard"

# =========================================================================
# Machine settings
# =========================================================================
# activate external dt
EXTERNAL_DT_ENABLED = "1"

# Define list of devicetree per supported storage
STM32MP_DT_FILES_EMMC   = "stm32mp257f-myboard"
# STM32MP_DT_FILES_SDCARD = "stm32mp257f-myboard"
# STM32MP_DT_FILES_NOR    = "stm32mp257f-myboard"

# EXTERNAL_DEVICETREE_SDCARD = "stm32mp257f-myboard"

EXTERNAL_DEVICETREE_EMMC = "stm32mp257f-myboard"

UBOOT_CONFIG[default_stm32mp25] = "stm32mp25_myboard_defconfig,,u-boot.dtb"

# =========================================================================
# Machine features
# =========================================================================
# MACHINE_FEATURES += "splashscreen"
# MACHINE_FEATURES += "watchdog"
# MACHINE_FEATURES += "bluetooth"
# MACHINE_FEATURES += "wifi"

# GPU
# MACHINE_FEATURES += "${@'gpu' if d.getVar('ACCEPT_EULA_'+d.getVar('MACHINE')) == '1' else ''}"
# MACHINE_FEATURES += "${@'openvx' if d.getVar('ACCEPT_EULA_'+d.getVar('MACHINE')) == '1' else ''}"
# MACHINE_FEATURES += "${@'opencl' if d.getVar('ACCEPT_EULA_'+d.getVar('MACHINE')) == '1' else ''}"
# MACHINE_FEATURES += "${@'vulkan' if d.getVar('ACCEPT_EULA_'+d.getVar('MACHINE')) == '1' else ''}"

# M33
# MACHINE_FEATURES += "m33copro"

# Bluetooth
# BLUETOOTH_LIST += "linux-firmware-bluetooth-bcm43xx"
# Wifi
# WIFI_LIST += "linux-firmware-bcm43439"
# PCIe
# PCI_LIST += "linux-firmware-rtl8168"

# ==========================================================================
# M33 Boards
# ==========================================================================
# Lists of boards/devicetree on which the m33 service MUST be started
# M33_BOARDS_START_AT_STARTUP = "stm32mp257f-myboard"
# M33_BOARDS_START_AT_STARTUP =+ "${@bb.utils.contains('EXTERNAL_DT_ENABLED', '1', 'stm32mp257f-myboard', '', d)}"

# =========================================================================
# OPTEE
# =========================================================================
# For sdk generation, declare the default board configuration to use.
ST_OPTEE_EXPORT_TA_REF_BOARD:stm32mp2common = "stm32mp257f-myboard.dts"

# =========================================================================
# WIC for sdcard raw image
# =========================================================================
WIC_CREATE_EXTRA_ARGS = "--no-fstab-update"
WKS_FILE_DEPENDS ?= " \
    virtual/bootloader \
    virtual/trusted-firmware-a \
    virtual-optee-os \
    ${@bb.utils.contains('ST_BOOTFS','1','st-image-bootfs', '', d)} \
    ${@bb.utils.contains('ST_VENDORFS','1','st-image-vendorfs', '', d)} \
    ${@bb.utils.contains('ST_USERFS','1','st-image-userfs', '', d)} \
"

FLASHLAYOUT_DEFAULT_SRC = "files/flashlayouts/FlashLayout_stm32mp25_ramfs.tsv"

EXTRA_IMAGEDEPENDS:append = " \
    ramfs-tools-native  \
    "

ST_BOOTFS   = "0"
ST_VENDORFS = "0"
ST_USERFS   = "0"
IMAGE_ROOTFS_MAXSIZE = "33554432"

OPTEE_WIC_FILE = "${@bb.utils.contains('ST_VENDORFS','1','sdcard-stm32mp257f-myboard-optee-vendorfs-2GB.wks.in','sdcard-stm32mp257f-myboard-optee-2GB.wks.in',d)}"

# for generated a WIC file, please uncomment the 2 following lines or add them to local.conf
#WKS_IMAGE_FSTYPES += "wic wic.bz2 wic.bmap"
#WKS_FILE += "${OPTEE_WIC_FILE}"
# DISTRO_FEATURES:remove = "alsa argp ext2 ext4 largefile ipv4 ipv6 multiarch pci wifi nfs usbgadget usbhost xattr zeroconf bluetooth bluez5 gstreamer  optee  splashscreen  wayland pam    kde  systemd  polkit  usrmerge  efi  initrd  autoresize pipewire opengl gplv3    pulseaudio gobject-introspection-data ldconfig"

DISTRO_FEATURES_DEFAULT:remove = "acl alsa bluetooth debuginfod ext2 ipv4 ipv6 pcmcia usbgadget usbhost wifi xattr nfs zeroconf pci 3g nfc x11 vfat seccomp locale "
CORE_IMAGE_BASE_INSTALL:remove = " packagegroup-base-extended locale "
GTK3DISTROFEATURES:remove = "x11 wayland"
# IMAGE_INSTALL:remove = " python3 weston pango wayland weston-cube dbus dbus-broker "
IMAGE_INSTALL:remove = " python3 weston pango wayland weston-cube dbus dbus-broker locale locale-base locale-base-en_us "
DISTRO_FEATURES:remove = " wayland x11 dbus dbus-broker python3 systemd locale "
DISTRO_FEATURES:remove = "alsa largefile ipv6 multiarch pci wifi nfs usbgadget usbhost xattr zeroconf bluetooth bluez5 gstreamer  optee  splashscreen  wayland kde  polkit  efi  autoresize pipewire opengl pulseaudio gobject-introspection-data ldconfig systemd "
DISTRO_FEATURES:append = " udev "
VIRTUAL-RUNTIME_init_manager = ""
VIRTUAL-RUNTIME_init_manager:remove = " systemd "
```
